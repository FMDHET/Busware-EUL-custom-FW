## main/Kconfig.projbuild
```kconfig
menu "Busware EUL22 Gateway"

    config EUL_DEFAULT_TCP_PORT
        int "Default TCP server port (Werkseinstellung)"
        default 5100
        range 1 65535
        help
            Wird bei Factory-Reset und ins NVS als Default geschrieben.
            5100 = MGW-LAN-Konvention der Eltako HA-Integration
            (https://github.com/FMDHET/home-assistant-eltako).

    config EUL_MAX_CLIENTS
        int "Maximum concurrent EnOcean TCP clients (Port 5100, nicht HTTP)"
        default 3
        range 1 8
        help
            Obergrenze gleichzeitiger Verbindungen zur EnOcean-TCP-Bridge.
            Das HTTP-Portal (Port 80) hat einen eigenen Socket-Pool und ist
            NICHT betroffen. 3 = 1x Home Assistant + Reserve.

    config EUL_CLIENT_TX_STREAM_SIZE
        int "Per-client outgoing stream buffer (bytes)"
        default 2048
        range 512 8192

    config EUL_MDNS_HOSTNAME_PREFIX
        string "mDNS hostname prefix (wird um MAC-suffix ergaenzt)"
        default "eul-gateway"

    config EUL_AP_SSID_PREFIX
        string "SoftAP SSID prefix (wird um MAC-suffix ergaenzt)"
        default "EUL22-Config"

    config EUL_AUTH_TCP_TIMEOUT_MS
        int "Timeout fuer TCP-AUTH Handshake (ms)"
        default 3000
        range 500 30000

    config EUL_AUTH_MAX_FAILS_PER_MIN
        int "Max fehlgeschlagene AUTH-Versuche pro Client-IP / Minute"
        default 5
        range 1 100

endmenu
```
